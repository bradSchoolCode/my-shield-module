#include "bradDactylV1_common.dtsi"

&default_transform {
    col-offset = <6>;
};

&kscan0 {
    col-gpios
        // Assuming a direct mirror of the left half
        = <&pro_micro 22 GPIO_ACTIVE_HIGH>
        , <&pro_micro 24 GPIO_ACTIVE_HIGH>
        , <&pro_micro 4 GPIO_ACTIVE_HIGH>
        , <&pro_micro 11 GPIO_ACTIVE_HIGH>
        , <&pro_micro 4 GPIO_ACTIVE_HIGH>
        , <&pro_micro 6 GPIO_ACTIVE_HIGH>
        ;
};
