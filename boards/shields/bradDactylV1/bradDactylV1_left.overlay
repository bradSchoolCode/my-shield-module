#include "bradDactylV1_common.dtsi"

&kscan0 {
    col-gpios
        = <&gpio0 6  GPIO_ACTIVE_HIGH> // col5
        , <&gpio0 4  GPIO_ACTIVE_HIGH> // col4
        , <&gpio1 11 GPIO_ACTIVE_HIGH> // col3
        , <&gpio0 0  GPIO_ACTIVE_HIGH> // col2
        , <&gpio1 24 GPIO_ACTIVE_HIGH> // col1
        , <&gpio1 22 GPIO_ACTIVE_HIGH> // col0
        ;
};
