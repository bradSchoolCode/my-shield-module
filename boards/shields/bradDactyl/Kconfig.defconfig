## boards/shields/bradDactyl/Kconfig.defconfig
```kconfig
if SHIELD_BRADDACTYL_LEFT

config ZMK_KEYBOARD_NAME
    default "bradDactyl"

config ZMK_SPLIT_ROLE_CENTRAL
    default y

endif

if SHIELD_BRADDACTYL_LEFT || SHIELD_BRADDACTYL_RIGHT

config ZMK_SPLIT
    default y

endif
```

## boards/shields/bradDactyl/Kconfig.shield
```kconfig
config SHIELD_BRADDACTYL_LEFT
    def_bool $(shields_list_contains,bradDactyl_left)

config SHIELD_BRADDACTYLV1_RIGHT
    def_bool $(shields_list_contains,bradDactyl_right)
```

## boards/shields/bradDactylV1/Kconfig.defconfig
```kconfig
if SHIELD_BRADDACTYLV1_LEFT

    config ZMK_KEYBOARD_NAME
        default "bradDactylV1"

    config ZMK_SPLIT_BLE_ROLE_CENTRAL
        default y

endif

if SHIELD_BRADDACTYLV1_LEFT || SHIELD_BRADDACTYLV1_RIGHT

    config ZMK_SPLIT
        default y

endif
```

## boards/shields/bradDactylV1/Kconfig.shield
```kconfig
config SHIELD_BRADDACTYLV1_LEFT
    def_bool $(shields_list_contains,bradDactylV1_left)

config SHIELD_BRADDACTYLV1_RIGHT
    def_bool $(shields_list_contains,bradDactylV1_right)
```
